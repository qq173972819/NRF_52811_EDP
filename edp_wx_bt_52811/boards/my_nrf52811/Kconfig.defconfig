## edp_wx_bt_52811/boards/my_nrf52811/Kconfig.my_nrf52811
```kconfig
# SPDX-License-Identifier: Apache-2.0

config BOARD_MY_NRF52811
	select SOC_NRF52811_QFAA if BOARD_MY_NRF52811_NRF52811
```

## edp_wx_bt_52811/boards/my_nrf52811/board.yml
```yaml
board:
  name: my_nrf52811
  full_name: Custom nRF52811 EPD Board
  vendor: nordic
  socs:
    - name: nrf52811
```

## edp_wx_bt_52811/tests/tests/epd_core/testcase.yaml
```yaml
tests:
  epd.core:
    tags:
      - epd
      - core
    platform_allow:
      - native_sim/native/64
      - qemu_cortex_m3
```

## edp_wx_bt_52811/tests/tests/epd_protocol/testcase.yaml
```yaml
tests:
  epd.protocol:
    tags:
      - epd
      - protocol
    platform_allow:
      - native_sim/native/64
      - qemu_cortex_m3
```

## edp_wx_bt_52811/tests/tests/power_logic/testcase.yaml
```yaml
tests:
  power.logic:
    tags:
      - power
      - battery
      - led
    platform_allow:
      - qemu_cortex_m3
```
